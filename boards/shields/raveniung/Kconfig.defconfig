## boards/shields/raveniung/Kconfig.defconfig
```kconfig
# Copyright (c) 2020 The ZMK Contributors
# SPDX-License-Identifier: MIT

if SHIELD_RAVENIUNG

config ZMK_KEYBOARD_NAME
    default "Raveniung"

endif
```

## boards/shields/raveniung/Kconfig.shield
```kconfig
# Copyright (c) 2020 The ZMK Contributors
# SPDX-License-Identifier: MIT

config SHIELD_RAVENIUNG
    def_bool $(shields_list_contains,raveniung)
```
